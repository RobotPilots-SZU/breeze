## drivers/Kconfig
```kconfig
rsource "./buzzer/Kconfig"
rsource "./bldcm/Kconfig"
rsource "./can_tx_manager/Kconfig"
rsource "./can_rx_manager/Kconfig"
rsource "./servo_motor_pwm/Kconfig"
rsource "./remote/Kconfig"
rsource "./rp_uart_stm32/Kconfig"
```

## drivers/remote/Kconfig
```kconfig
# Copyright (c) 2026 RobotPilots
# SPDX-License-Identifier: Apache-2.0

menuconfig REMOTE
	bool "Remote drivers"
	help
	  Include remote drivers in the system configuration.

if REMOTE

module = REMOTE
module-str = Remote
source "subsys/logging/Kconfig.template.log_config"

# 协议选择。choice 里的成员 config 不能跨文件 source，所以两个驱动的
# symbol 直接写在这里，不再拆 Kconfig.DT7 / Kconfig.VT13——拆了就得在主
# 文件里另抄一份 choice 成员，两边容易走散。
#
# 注意 DTS 与 Kconfig 是单向关系：Kconfig 能读 DT_HAS_*_ENABLED，反之不行。
# DT_HAS_RP_VT13_REMOTE_ENABLED 这类符号由 dts/bindings/ 下的 yaml 生成，
# 其取值再由最终 DTS 里有没有对应的 status="okay" 节点决定。

choice REMOTE_PROTOCOL
    prompt "Remote protocol"
    default REMOTE_PROTOCOL_DT7
    help
      Which remote controller protocol to build in. Exactly one driver is
      compiled; switch without adding a build directory, e.g.:

        west build -d build -- -DCONFIG_REMOTE_PROTOCOL_VT13=y \
                               -DCONFIG_REMOTE_PROTOCOL_DT7=n

      Both options must be spelled out: Zephyr caches every CONFIG_* passed
      on the command line and replays it on later invocations, so leaving
      the old one out silently keeps the old protocol selected.

      An option whose devicetree node is missing or disabled cannot be
      selected, so the choice falls back to the other one rather than
      silently building nothing.

config REMOTE_PROTOCOL_DT7
    bool "DT7 (DBUS, 100000 8E1, 18-byte frame)"
    depends on DT_HAS_RP_DT7_REMOTE_ENABLED

config REMOTE_PROTOCOL_VT13
    bool "VT13 / VT03 (921600 8N1, 21-byte frame)"
    depends on DT_HAS_RP_VT13_REMOTE_ENABLED

endchoice

config DT7_REMOTE
    bool
    default y if REMOTE_PROTOCOL_DT7
    help
      DJI DT7 remote controller, DBUS protocol (normally through a DR16
      receiver). Selected by REMOTE_PROTOCOL_DT7; requires a devicetree
      node with compatible = "rp,dt7-remote".

config VT13_REMOTE
    bool
    default y if REMOTE_PROTOCOL_VT13
    help
      DJI VT13/VT03 image transmission remote controller. Selected by
      REMOTE_PROTOCOL_VT13; requires a devicetree node with
      compatible = "rp,vt13-remote".

config REMOTE_INIT_PRIORITY
    int "Remote init priority"
    default 80
    range 0 99
    depends on DT7_REMOTE || VT13_REMOTE
    help
      Device init priority at POST_KERNEL stage.

# rc_thread.c 的两项线程参数（栈大小 / 优先级）不在这里，它们属于应用侧：
# 解析线程由应用自己建，配置项跟着实现走，见 samples/boards/dm_mc02/remote/Kconfig。

endif # REMOTE
```

## drivers/sensor/bosch/bmi08x/Kconfig
```kconfig
# Copyright (c) 2026 RobotPilots

# SPDX-License-Identifier: Apache-2.0

config RP_BMI08X_STREAM
    bool "Use custom BMI08x stream files"
    default y
    depends on BMI08X
    depends on BMI08X_ACCEL_STREAM || BMI08X_GYRO_STREAM
    help
      Replace official bmi08x_accel_stream.c and bmi08x_gyro_stream.c
      with custom versions from this module.
```

## dts/bindings/bldcm/rp,dm-can-motor.yaml
```yaml
# Copyright (c) 2025 Sassinak
# SPDX-License-Identifier: Apache-2.0

description:
  Custom CAN-controlled DM motor device.


compatible: "rp,dm-can-motor"

properties:
  can-bus:
    type: phandle
    required: true
    description: |
      Reference to the CAN controller used to communicate with the motor.
      On STM32H7 this is typically one of: &fdcan1, &fdcan2, &fdcan3.

  rx-manager:
    type: phandle
    required: false
    description: |
      Reference to a shared CAN RX manager (rp,can-rx-manager) bound to the same can-bus.
      When present, motor drivers should receive frames through the manager instead of
      creating their own RX threads/message queues.

  tx-manager:
    type: phandle
    required: false
    description: |
      Reference to a shared CAN TX manager (rp,can-tx-manager) bound to the same can-bus.
      When present, motor drivers should send frames through the manager instead of
      sending directly via the CAN controller.

  can-fd:
    type: boolean
    description: |
      Enable CAN FD framing for the motor (up to 64 data bytes).
      If absent, classic CAN (up to 8 data bytes) is assumed.

  label:
    type: string
    description: |
      Human readable string describing this motor.

  tx-id:
    type: int
    required: true
    description: |
      CAN identifier used when sending commands to the motor.
      By default this is interpreted as an 11-bit (standard) ID unless
      the 'extended-id' property is present.

  rx-id:
    type: int
    required: true
    description: |
      CAN identifier expected in frames received from the motor.

  motor-type:             # 设计这个字段是因为不同类型的电机，接收的数据格式不一样
    type: string
    required: true
    enum:
      - "unknown"
      - "DM43"
      - "DM60"
      - "DM80"
      - "DM100"
    description: |
      Type of DM motor.

  motor-encoder:
    type: int
    required: true
    description: |
      Number of encoder counts per revolution for the motor.

  motor-transmission-ratio:
    type: int
    required: true
    description: |
      Gearbox transmission ratio (output shaft speed / motor speed).ex: 1:19 -> 19

  Tx-feq:
    type: int
    required: true
    description: |
      Frequency (in Hz) at which to send commands to the motor. 0 means manaual send only.
  
  vel-max:
    type: int
    required: true
    default: 45000
    description: |
      Speed limit range of the motor. The first value is the maximum,
      and the second value is the minimum. This depends on the host
      configuration and is used to compute the real speed value (rad/s).
      attention: 45000 is scaled by 1000, which means the real speed limit is 45 rad/s.

  tq-max:
    type: int
    required: true
    default: 18000 
    description: |
      Torque limit range of the motor. The first value is the maximum
      and the second value is the minimum. This depends on the host
      configuration and is used to compute the real torque value.
      attention: 18000 is scaled by 1000, which means the real torque limit is 18.

  pos-max:
    type: int
    required: true
    default: 12000       
    description: |
      Position limit range of the motor. The first value is the maximum
      and the second value is the minimum. This depends on the host
      configuration and is used to compute the real position value.
      attention: 12000 is scaled by 1000, which means the real position limit is 12.

  mit-params-limit:
    type: array
    required: true
    default: [500000, 0, 5000, 0]
    description: |
      Parameter limits for MIT control mode: Kp_max, Kp_min, Kd_max, Kd_min.
      attention: Kp and Kd are scaled by 1000, which means the real limits are 500 and 5.

  control-mode:
    type: string
    required: true
    enum:
      - "mul_torque"            # 扭矩控制模式  broadcast mode
      - "MIT"                   # MIT模式             帧ID就是上位机设定的ID
      - "pos-vel"               # 位置速度控制模式      帧ID是设定的ID+0x100的偏移
      - "velocity"              # 速度控制模式          帧ID是设定的ID+0x200的偏移
    description: |
      Control mode of the motor.

  
```

## dts/bindings/remote/rp,dt7-remote.yaml
```yaml
# SPDX-License-Identifier: Apache-2.0

description:
  DJI DT7 Remote Controller (DBUS protocol, normally via a DR16 receiver)

compatible: "rp,dt7-remote"

properties:
  uart:
    type: phandle
    required: true
    description: |
      UART peripheral used for remote communication.

  label:
    type: string
    description: |
      Human readable string describing the Remote. It can be used by an
      application to identify this Remote or to retrieve its number/index
      (i.e. child node number) on the parent device.
```

## dts/bindings/remote/rp,vt13-remote.yaml
```yaml
# SPDX-License-Identifier: Apache-2.0

description:
  DJI VT13 / VT03 image transmission remote controller. 921600 8N1,
  21-byte frame starting with 0xA9 0x53 and ending with a CRC16.

compatible: "rp,vt13-remote"

properties:
  uart:
    type: phandle
    required: true
    description: |
      UART peripheral used for remote communication.

  label:
    type: string
    description: |
      Human readable string describing the Remote. It can be used by an
      application to identify this Remote or to retrieve its number/index
      (i.e. child node number) on the parent device.
```

## dts/bindings/rp_uart_stm32/rp,st-stm32-uart.yaml
```yaml
# Copyright (c) 2026 RobotPilots-SZU
# SPDX-License-Identifier: Apache-2.0

description: STM32 UART

compatible: "rp,st-stm32-uart"

include: st,stm32-uart-base.yaml
```

## samples/buzzer/sample.yaml
```yaml
sample:
  name: Breeze buzzer sample
tests:
  sample.breeze.buzzer:
    platform_allow:
      - damiao_mc02
    tags:
      - buzzer
      - pwm
```

## samples/servo_motor_pwm/Kconfig
```kconfig
# Copyright (c) 2025 RobotPilots-SZU
# SPDX-License-Identifier: Apache-2.0

source "Kconfig.zephyr"
```

## samples/ws2812/sample.yaml
```yaml
sample:
  name: Breeze WS2812 sample
tests:
  sample.breeze.ws2812:
    platform_allow:
      - damiao_mc02
    tags:
      - led
      - led_strip
```
