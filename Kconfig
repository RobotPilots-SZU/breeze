## Kconfig
```kconfig
# Copyright (c) 2025 RobotPilots-SZU
# SPDX-License-Identifier: Apache-2.0
#
# This Kconfig file is picked by the Zephyr build system because it is defined
# as the module Kconfig entry point (see zephyr/module.yml). You can browse
# module options by going to Zephyr -> Modules in Kconfig.

rsource "drivers/Kconfig"
rsource "lib/Kconfig"

menuconfig BREEZE
    bool "Breeze"
    select FPU
    help
        Enable Breeze, a lightweight and modular framework for RoboMaster
        competitions. Breeze provides a set of tools and libraries to help
        you build and manage your RoboMaster robot software efficiently.

    config BREEZE_KERNEL
    bool "Enable Breeze required kernel features"
    default y
    select THREAD_RUNTIME_STATS
    help
        Enable Breeze kernel features that are required for the framework to
        function properly.

    config BREEZE_LIB_C
    bool "Enable full C libraries"
    default y
    select GNU_C_EXTENSIONS
    select REQUIRES_FULL_LIBC
    select REQUIRES_FLOAT_PRINTF
    help
        Enable the C libraries fully support.

    config BREEZE_LIB_CPP
    bool "Enable full C++ libraries"
    default y
    select CPP
    select REQUIRES_FULL_LIBCPP
    help
        Enable the C++ libraries fully support.

    config BREEZE_LOG
    bool "Enable Breeze logging"
    default y
    select LOG
    select LOG_TIMESTAMP_USE_REALTIME
    help
        Enable logging support in Breeze.

    config BREEZE_EXTERNAL_LIB
    bool "Enable external libraries that breeze required"
    default y
    select ETL
    help
        Enable external libraries that breeze required
```

## boards/damiao/mc02/Kconfig.damiao_mc02
```kconfig
# Copyright (c) 2025 RobotPilots-SZU

config BOARD_DAMIAO_MC02
	select SOC_STM32H723XX
```

## boards/damiao/mc02/board.yml
```yaml
board:
  name: damiao_mc02
  vendor: damiao
  full_name: Damiao MC02
  socs:
    - name: stm32h723xx
```

## boards/damiao/mc02/damiao_mc02_defconfig
```kconfig
# Copyright (c) 2025 RobotPilots-SZU

# Enable MPU
CONFIG_ARM_MPU=y

# Enable HW stack protection
CONFIG_HW_STACK_PROTECTION=y

# Enable drivers
CONFIG_DMA=y
CONFIG_GPIO=y

CONFIG_SERIAL=y
CONFIG_UART_STM32=y

CONFIG_SPI=y
CONFIG_SPI_STM32=y
CONFIG_SPI_STM32_DMA=y

CONFIG_CAN=y
CONFIG_CAN_STM32H7_FDCAN=y

# On-board devices
CONFIG_CONSOLE=y
# CONFIG_UART_CONSOLE=y
CONFIG_SENSOR=y
CONFIG_SENSOR_ASYNC_API=y
CONFIG_BMI08X=y
```

## boards/dji/rm_typec/Kconfig.rm_typec
```kconfig
# Copyright (c) 2016 Linaro Limited.
# SPDX-License-Identifier: Apache-2.0

config BOARD_RM_TYPEC
    bool "DJI C Development Board"
    select SOC_STM32F407XG
```

## boards/dji/rm_typec/board.yml
```yaml
board:
  name: rm_typec
  full_name: DJI RoboMaster Type-C Board
  vendor: dji
  socs:
    - name: stm32f407xx
```

## boards/dji/rm_typec/rm_typec_defconfig
```kconfig
# SPDX-License-Identifier: Apache-2.0

# Enable MPU
CONFIG_ARM_MPU=y

# Enable HW stack protection
CONFIG_HW_STACK_PROTECTION=y

# console
CONFIG_CONSOLE=y
CONFIG_UART_CONSOLE=y

# Enable logging
CONFIG_LOG=y

#RTT
CONFIG_USE_SEGGER_RTT=y

# Enable drivers
CONFIG_DMA=y
CONFIG_GPIO=y
CONFIG_COUNTER=y
CONFIG_PWM=y
CONFIG_SERIAL=y
CONFIG_SPI=y
CONFIG_I2C=y
CONFIG_CAN=y

# On-board devices
CONFIG_SENSOR=y
CONFIG_BMI08X=y

# USB CDC ACM
CONFIG_USB_DEVICE_STACK_NEXT=y
CONFIG_SERIAL=y
CONFIG_UART_LINE_CTRL=y
CONFIG_USBD_CDC_ACM_CLASS=y
CONFIG_USBD_LOG_LEVEL_ERR=y
CONFIG_UDC_DRIVER_LOG_LEVEL_ERR=y
CONFIG_USBD_CDC_ACM_LOG_LEVEL_ERR=y
```

## drivers/buzzer/Kconfig
```kconfig
# Copyright (c) 2025 RobotPilots
# SPDX-License-Identifier: Apache-2.0

menuconfig BUZZER
	bool "Buzzer drivers"
	help
	  Include buzzer drivers in the system configuration.

if BUZZER

module = BUZZER
module-str = Buzzer
source "subsys/logging/Kconfig.template.log_config"

config BUZZER_INIT_PRIORITY
    int "MLT5020 init priority"
    default 60
    range 0 99
    depends on MLT5020_BUZZER_PWM
    help
      Device init priority at POST_KERNEL stage.


rsource "./Kconfig.MLT5202"

endif # BUZZER
```

## drivers/buzzer/Kconfig.MLT5202
```kconfig
# Copyright (c) 2025 RobotPilots
# SPDX-License-Identifier: Apache-2.0

config MLT5020_BUZZER_PWM
    bool "MLT5020 PWM buzzer driver"
    default y
    depends on DT_HAS_RP_PWM_BUZZER_ENABLED
    select PWM
    help
      Enable support for MLT5020 buzzer using a PWM controller.
      Requires a device-tree node with compatible = "rp,pwm-buzzer".
```

## drivers/can_rx_manager/Kconfig
```kconfig
# SPDX-License-Identifier: Apache-2.0
# Copyright (c) 2025 RobotPilots-SZU
menuconfig CAN_RX_MANAGER
    bool "CAN RX manager"
    default n
    depends on CAN
    select CAN_MCAN if CAN
    help
      Enable per-CAN-bus RX manager which receives frames into a message queue and dispatches
      them to registered software handlers.

if CAN_RX_MANAGER

# 依赖CAN_MCAN，避免非MCAN场景下无效
config CAN_MCAN_FIFO0_DEPTH
    int "RX FIFO0 Depth (MCAN)"
    default 32
    depends on CAN_MCAN
    range 1 64
    help
      Number of elements in MCAN RX FIFO0. Matches your working hardware configuration.

config CAN_MCAN_FIFO0_ELEMENT_SIZE                  # 数据帧大小
    int "RX FIFO0 Element Size (bytes, MCAN)"
    default 8
    depends on CAN_MCAN
    range 4 64
    help
      Size of each element in MCAN RX FIFO0. Matches your working hardware configuration.

config CAN_MCAN_SD_FILTERS_NBR                      # 标准滤波器数量
    int "Standard Filter Number (MCAN)"
    default 1
    depends on CAN_MCAN
    range 0 128
    help
      Number of standard ID filters for MCAN.

config CAN_MCAN_EX_FILTERS_NBR                      # 扩展滤波器数量
    int "Extended Filter Number (MCAN)"
    default 0
    depends on CAN_MCAN
    range 0 64
    help
      Number of extended ID filters for MCAN.

config CAN_MCAN_TX_FIFO_QUEUE_ELTS_NBR              # 发送FIFO/队列元素数量
    int "TX FIFO/Queue Element Number (MCAN)"
    default 32
    depends on CAN_MCAN
    range 1 64
    help
      Number of elements in MCAN TX FIFO/Queue.

config CAN_MCAN_TX_ELEMENT_SIZE                     # 发送FIFO/队列元素大小
    int "TX Element Size (bytes, MCAN)"
    default 8
    depends on CAN_MCAN
    range 4 64
    help
      Size of each element in MCAN TX FIFO/Queue.

config CAN_RX_MANAGER_INIT_PRIORITY
        int "Init priority"
        default 90
        range 0 99
        help
            Device init priority for the CAN RX manager.
            Must be greater (later) than the CAN controller init priority.

config CAN_RX_MANAGER_MAX_LISTENERS
    int "Max number of registered listeners"
    default 64
    range 1 256

config CAN_RX_MANAGER_RX_MSGQ_LEN
    int "RX message queue length"
    default 384
    range 4 1024

config CAN_RX_MANAGER_RX_STACK_SIZE
    int "RX thread stack size"
    default 2048
    range 512 16384

config CAN_RX_MANAGER_RX_THREAD_PRIO
    int "RX thread priority (lower is higher)"
    default 5
    range 0 15

config CAN_RX_MANAGER_MSGQ_MONITOR
        bool "Monitor RX msgq drops (msgq full)"
        default n
        help
            Counts CAN frames dropped because the RX message queue is full (k_msgq_put() failed from
            ISR context). The RX thread will log warnings when drops occur.

config CAN_RX_MANAGER_BATCH_LIMIT
        int "RX batch limit per wake"
        default 16
        range 1 64
        help
            Maximum number of frames the shared RX thread will process per wake before yielding.
            Prevents long single-run processing and stack/CPU starvation on high-load systems.

config CAN_RX_MANAGER_STACK_WARN_THRESHOLD
        int "RX worker stack warn threshold (bytes)"
        default 256
        range 0 16384
        help
            If non-zero, the shared RX worker will check its remaining stack and emit a
            LOG_WRN when the free stack bytes fall below this threshold.

config CAN_RX_MANAGER_MSGQ_WARN_EVERY_N_DROPS
        int "Warn every N dropped frames"
        default 1
        range 1 1000000
        depends on CAN_RX_MANAGER_MSGQ_MONITOR
        help
            Emit a LOG_WRN each time the cumulative drop counter increases by N.

endif # CAN_RX_MANAGER
```

## drivers/can_tx_manager/Kconfig
```kconfig
# SPDX-License-Identifier: Apache-2.0

menuconfig CAN_TX_MANAGER
    bool "CAN TX manager"
    default n
    depends on CAN
    help
      Enable per-CAN-bus TX manager which manages transmission of CAN frames from registered software handlers.
      them to registered software handlers.

if CAN_TX_MANAGER

config CAN_TX_MANAGER_INIT_PRIORITY
        int "Init priority"
        default 91
        range 0 99
        help
            Device init priority for the CAN TX manager.
            Must be greater (later) than the CAN controller init priority.

config MAX_DEVICE_SENDERS
    int "singal can bus Max number of registered senders"
    default 16
    range 1 256

config MAX_CAN_FRAMES
    int "singal can bus Max number of CAN frames in TX queue"
    default 16
    range 1 256

config CAN_TX_MANAGER_THREAD_STACK_SIZE
    int "CAN TX manager periodic thread stack size (bytes)"
    default 1024
    range 512 8192

config CAN_TX_MANAGER_THREAD_PRIORITY
    int "CAN TX manager periodic thread priority"
    default 6
    range 0 14

endif
```

## drivers/motor/Kconfig
```kconfig
menuconfig MOTOR
    bool "Motor drivers"
    default n
    depends on CAN

if MOTOR

config MOTOR_DJI_HEARTBEAT_OFFLINE_TIMEOUT_MS
        int "DJI motor offline timeout (ms)"
        default 100
        range 1 60000
        help
            If no CAN frames are received for longer than this time, the motor is
            considered offline. Unit: milliseconds.

config MOTOR_DJI_HEARTBEAT_AUTOCHECK
        bool "DJI motor heartbeat auto-check (workqueue)"
        default n
        help
            Periodically calls motor_dji_update_heartbeat_status() using a delayable
            work item (shared system workqueue). This avoids creating one thread per
            motor device.

config MOTOR_DJI_HEARTBEAT_POLL_PERIOD_MS
        int "DJI motor heartbeat poll period (ms)"
        default 10
        range 1 1000
        depends on MOTOR_DJI_HEARTBEAT_AUTOCHECK
        help
            Poll period for heartbeat auto-check. Unit: milliseconds.

config MOTOR_INIT_PRIORITY
        int "Init priority"
        default 93
        range 0 99
        help
            Device init priority for motor drivers.
            Must be greater (later) than the CAN controller init priority.

config MOTOR_LOG_LEVEL
    int "Motor log level"
    default 3
    range 0 4
    help
      Log level for motor drivers (0=none, 4=debug).

endif # MOTOR
```

## drivers/remote/Kconfig.DR16
```kconfig
# Copyright (c) 2026 RobotPilots
# SPDX-License-Identifier: Apache-2.0

config DR16_REMOTE
    bool "DR16 Remote driver"
    default y
    depends on DT_HAS_RP_REMOTE_ENABLED
    help
      Enable support for DJI DR16/DT7 remote controller.
      Requires a device-tree node with compatible = "rp,remote".
```

## drivers/servo_motor_pwm/Kconfig
```kconfig
# Copyright (c) 2025 RobotPilots
# SPDX-License-Identifier: Apache-2.0

menuconfig SERVO_MOTOR_PWM
    bool "Servo Motor PWM drivers"
    default n
    depends on PWM
    help
      Enable PWM-based servo motor driver.

if SERVO_MOTOR_PWM

config SERVO_INIT_PRIORITY
    int "Init priority"
    default 92
    range 0 99
    help
      Initialization priority for servo motor PWM driver.

config SERVO_MOTOR_PWM_LOG_LEVEL
    int "Servo log level"
    default 3
    range 0 4
    help
      0 = LOG_LEVEL_NONE, 1 = ERR, 2 = WRN, 3 = INF, 4 = DBG

endif # SERVO_MOTOR_PWM
```

## dts/bindings/buzzer/rp,pwm-buzzer.yaml
```yaml
# Copyright (c) 2025 Sassinak
# SPDX-License-Identifier: Apache-2.0

description: 
  Custom PWM-controlled Buzzer

compatible: "rp,pwm-buzzer"

properties:
  pwms:
    required: true
    type: phandle-array
    description: |
      Reference to a PWM instance.

  label:
    type: string
    description: |
      Human readable string describing the Buzzer. It can be used by an
      application to identify this Buzzer or to retrieve its number/index
      (i.e. child node number) on the parent device.

  default-frequency:
    required: true
    type: int
    description: |
      The frequency of the buzzer in Hertz.
    default: 2000

  default-volume:
    required: true
    type: int
    description: |
      Number of volume levels supported by the buzzer. range is 0-100.
    default: 50
```

## dts/bindings/can/rp,can-rx-manager.yaml
```yaml
# Copyright (c) 2025 RobotPilots-SZU
# SPDX-License-Identifier: Apache-2.0

description: Custom CAN RX manager (one per CAN bus).

compatible: "rp,can-rx-manager"

properties:
  can-bus:
    type: phandle
    required: true
    description: Reference to the CAN controller used for receiving frames.

  label:
    type: string
    description: Human readable label.
```

## dts/bindings/can/rp,can-tx-manager.yaml
```yaml
# Copyright (c) 2025 RobotPilots-SZU
# SPDX-License-Identifier: Apache-2.0

description: Custom CAN TX manager (one per CAN bus).

compatible: "rp,can-tx-manager"

properties:
  can-bus:
    type: phandle
    required: true
    description: Reference to the CAN controller used for transmitting frames.

  label:
    type: string
    description: Human readable label.
```

## dts/bindings/motor/rp,dji-can-motor.yaml
```yaml
# Copyright (c) 2025 Sassinak
# SPDX-License-Identifier: Apache-2.0

description:
  Custom CAN-controlled DJI motor device.


compatible: "rp,dji-can-motor"

properties:
  can-bus:
    type: phandle
    required: true
    description: |
      Reference to the CAN controller used to communicate with the motor.
      On STM32H7 this is typically one of: &fdcan1, &fdcan2, &fdcan3.

  rx-manager:
    type: phandle
    required: false
    description: |
      Reference to a shared CAN RX manager (rp,can-rx-manager) bound to the same can-bus.
      When present, motor drivers should receive frames through the manager instead of
      creating their own RX threads/message queues.

  tx-manager:
    type: phandle
    required: false
    description: |
      Reference to a shared CAN TX manager (rp,can-tx-manager) bound to the same can-bus.
      When present, motor drivers should send frames through the manager instead of
      sending directly via the CAN controller.

  can-fd:
    type: boolean
    description: |
      Enable CAN FD framing for the motor (up to 64 data bytes).
      If absent, classic CAN (up to 8 data bytes) is assumed.

  label:
    type: string
    description: |
      Human readable string describing this motor.

  tx-id:
    type: int
    required: true
    description: |
      CAN identifier used when sending commands to the motor.
      By default this is interpreted as an 11-bit (standard) ID unless
      the 'extended-id' property is present.

  rx-id:
    type: int
    required: true
    description: |
      CAN identifier expected in frames received from the motor.

  motor-type:             # 设计这个字段是因为不同类型的电机，接收的数据格式不一样
    type: string
    required: true
    enum:
      - "unknown"
      - "M3508"
      - "M2006"
      - "M6020"
    description: |
      Type of DJI motor.

  motor-encoder:
    type: int
    required: true
    description: |
      Number of encoder counts per revolution for the motor.

  motor-transmission-ratio:
    type: int
    required: true
    description: |
      Gearbox transmission ratio (output shaft speed / motor speed).ex: 1:19 -> 19

  Tx-feq:
    type: int
    required: true
    description: |
      Frequency (in Hz) at which to send commands to the motor. 0 means manaual send only.

  control-mode:
    type: string
    required: true
    enum:
      - "torque"                # 扭矩控制模式
      - "velocity"              # 速度控制模式
    description: |
      Control mode of the motor.
```
