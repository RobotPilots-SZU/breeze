## dts/bindings/remote/rp,remote.yaml
```yaml
# SPDX-License-Identifier: Apache-2.0

description:
  DJI DR16 Remote Controller

compatible: "rp,remote"

properties:
  uart:
    type: phandle
    required: true
    description: |
      UART peripheral used for remote communication.

  label:
    type: string
    description: |
      Human readable string describing the Remote. It can be used by an
      application to identify this Remote or to retrieve its number/index
      (i.e. child node number) on the parent device.
```

## dts/bindings/servo-motor-pwm/rp,servo-motor-pwm.yaml
```yaml
# Copyright (c) 2026 RobotPilots-SZU
# SPDX-License-Identifier: Apache-2.0

description: PWM-driven servo motor.

include: base.yaml

compatible: "rp,servo-motor-pwm"

properties:
  pwms:
    required: true
    type: phandle-array
    description: |
      PWM specifier driving the servo motor. Expected cells:
        - channel: PWM channel number
        - period: PWM period in nanoseconds
        - flags: PWM flags

  min-pulse:
    required: true
    type: int
    description: |
      Minimum pulse width in nanoseconds.

  max-pulse:
    required: true
    type: int
    description: |
      Maximum pulse width in nanoseconds.

  max-angle:
    required: true   
    type: int
    description: |
      Maximum angle in degrees.

  min-angle:
    required: false
    type: int
    description: |
      Minimum angle (degrees). Optional, if not provided, the driver will assume 0 degrees.
```

## samples/buzzer_pwm/Kconfig
```kconfig
# Copyright (c) 2024 TOKITA Hiroshi
# SPDX-License-Identifier: Apache-2.0

source "Kconfig.zephyr"

menu "Buzzer Configuration"

config SONG_TWINKLE_STAR_ENABLE
	bool "Enable Twinkle Star Song"
	default y
	help
	  Enable or disable the compilation of the Twinkle Star song.

config SONG_HAPPY_BIRTHDAY_ENABLE
	bool "Enable Happy Birthday Song"
	default y
	help
	  Enable or disable the compilation of the Happy Birthday song.

config SONG_BEEP_TEST_ENABLE
	bool "Enable Beep Test Song"
	default y
	help
	  Enable or disable the compilation of the Beep Test song.

config SONG_GAME_OF_THRONES_ENABLE
	bool "Enable Game of Thrones Song"
	default y
	help
	  Enable or disable the compilation of the Game of Thrones song.

config SONG_SUPER_MARIO_ENABLE
	bool "Enable Super Mario Song"
	default y
	help
	  Enable or disable the compilation of the Super Mario song.

config SONG_MAX_VERSTAPPEN_ENABLE
	bool "Enable Max Verstappen Song"
	default y
	help
	  Enable or disable the compilation of the Max Verstappen song.

config SONG_PIRATES_CARIBBEAN_ENABLE
	bool "Enable Pirates of the Caribbean Song"
	default y
	help
	  Enable or disable the compilation of the Pirates of the Caribbean song.

config SONG_GALA_ENABLE
	bool "Enable Gala Song"
	default y
	help
	  Enable or disable the compilation of the Gala song.

endmenu
```

## west.yml
```yaml
manifest:

  defaults:
    remote: robotpilots

  remotes:
    - name: robotpilots
      url-base: https://github.com/RobotPilots-SZU
    - name: upstream
      url-base: https://github.com/zephyrproject-rtos

  projects:
    - name: breeze-app-template
      revision: main
      path: breeze-app/breeze-app-template
    - name: zephyr
      remote: upstream
      revision: main
      path: zephyr
      import:
        path-prefix: breeze-sdk
        # By using name-allowlist we can clone only the modules that are
        # strictly needed by the application.
        name-allowlist:
          - cmsis
          - cmsis_6
          - cmsis-nn
          - cmsis-dsp
          - segger
          - hal_st
          - hal_stm32
          - fatfs
          - littlefs
          - picolibc

  self:
    path: breeze
    import: submanifests
```
