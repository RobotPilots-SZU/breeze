## CMakeLists.txt
```
cmake_minimum_required(VERSION 3.20)

set(BOARD damiao_mc02)
find_package(Zephyr REQUIRED HINTS $ENV{ZEPHYR_BASE})
project(remote)

list(APPEND DTC_BINDINGS_DIRS
    ${bindings_DIR}/remote
)

# rc_thread.c 以前在 drivers/remote 里，但组帧 + 解析线程属于应用职责，不是驱动该做的：
# 驱动只吐字节（remote_set_rx_cb）并说明本协议帧的格式（remote_get_parser_ops），
# 字节怎么拼成帧、在哪个线程解析都在这里。
target_sources(app PRIVATE
    src/main.c
    src/rc_thread.c
)

target_include_directories(app PRIVATE include)
```

## Kconfig
```
source "Kconfig.zephyr"
source "../../breeze/drivers/remote/Kconfig"
```

## prj.conf
```kconfig
CONFIG_REMOTE=y
CONFIG_REMOTE_PROTOCOL_DT7=y
# CONFIG_REMOTE_PROTOCOL_VT13=y
CONFIG_CPP=y

# UART Configuration
CONFIG_UART_STM32=n
CONFIG_UART_STM32_FIX=y
CONFIG_UART_ASYNC_API=y

# RTT (Real-Time Transfer) Configuration
CONFIG_ASSERT=y
CONFIG_USE_SEGGER_RTT=y
CONFIG_RTT_CONSOLE=y
CONFIG_UART_CONSOLE=n

CONFIG_DCACHE=n

# Optional: Enable RTT logging backend
CONFIG_LOG_BACKEND_RTT=y
CONFIG_LOG_BACKEND_UART=n
# CONFIG_REMOTE_LOG_LEVEL_DBG=y
CONFIG_LOG=y
```

## damiao_mc02.overlay
```dts
/ {
    remote: remote0 {
        status = "okay";
        compatible = "rp,remote";
        uart = <&uart5>;
    };
    aliases {
        remote0 = &remote;
    };
};
```

## boards/damiao_mc02.overlay
```dts
/ {
    remote_dt7: dt7 {
        status = "okay";
        compatible = "rp,dt7-remote";
        uart = <&uart5>;
    };

    remote_vt13: vt13 {
        status = "okay";
        compatible = "rp,vt13-remote";
        uart = <&usart1>;
    };
};
```

## boards/rm_typec.overlay
```dts
/* samples/boards/dm_mc02/remote/boards/rm_typec.overlay */
/*
 * Copyright (c) 2026 RobotPilots
 * SPDX-License-Identifier: Apache-2.0
 */

/* This file will automatic applyed when using rm_typec board */

/ {
    remote_dt7: dt7 {
        status = "okay";
        compatible = "rp,dt7-remote";
        uart = <&usart3>;
    };

    remote_vt13: vt13 {
        status = "okay";
        compatible = "rp,vt13-remote";
        uart = <&usart1>;
    };
};
```

## src/main.c
```c
#include "rc_thread.h"

#include <drivers/remote/rc_common.h>
#include <drivers/remote/remote.h>
#include <zephyr/device.h>
#include <zephyr/kernel.h>
#include <zephyr/logging/log.h>
#include <zephyr/sys/util.h>

LOG_MODULE_REGISTER(remote_app, LOG_LEVEL_INF);

#define DR16_REMOTE_NODE DT_ALIAS(remote0)
#if !DT_NODE_HAS_STATUS_OKAY(DR16_REMOTE_NODE)
#error "DT alias 'remote0' 未定义或禁用"
#endif

static const struct device* remote_dev;
static rc_sensor_t* sensor;

/**
 *	@brief	按键状态机的 1ms 节拍
 *
 * rc_keyboard_update() 每调一次给按住时长 +1，所以固定 1ms 调用时
 * key_board_info_t::cnt 的单位就是毫秒，与 KEY_*_CNT_MAX 的注释对应。
 *
 * 回调运行在系统时钟中断上下文。掉线时直接跳过：否则 value 会停在最后一帧的
 * 按下态，cnt 一路涨到 cnt_max，按键被永久判成长按。
 */
static void rc_key_tick(struct k_timer* timer) {
  ARG_UNUSED(timer);

  if (sensor != NULL && sensor->is_online) {
    rc_keyboard_update(sensor->info);
  }
}

K_TIMER_DEFINE(rc_key_timer, rc_key_tick, NULL);

struct app_data {
  uint32_t last_receive_time;
  uint32_t packet_count;
};

static struct app_data my_app_data = {
    .last_receive_time = 0,
    .packet_count = 0,
};

static void remote_data_ready(const struct device* dev, rc_sensor_t* sns, void* user_data) {
  struct app_data* data = (struct app_data*)user_data;
  data->last_receive_time = k_uptime_get_32();
  data->packet_count++;
}

int remote_app_init(void) {
  remote_dev = DEVICE_DT_GET(DR16_REMOTE_NODE);
  if (!device_is_ready(remote_dev)) {
    LOG_ERR("Remote device not ready");
    return -1;
  }
  sensor = remote_get_sensor(remote_dev);
  if (!sensor) {
    LOG_ERR("Failed to get remote sensor");
    return -1;
  }

  /* 组帧 + 解析线程在应用侧，见 src/rc_thread.c */
  if (rc_parse_attach(remote_dev) < 0) {
    LOG_ERR("Failed to attach remote parser");
    return -1;
  }
  rc_parse_set_data_ready_cb(remote_dev, remote_data_ready, &my_app_data);

  /* 1ms 周期推进按键状态机，见 rc_key_tick() */
  k_timer_start(&rc_key_timer, K_MSEC(1), K_MSEC(1));
  return 0;
}

int main(void) {
  if (remote_app_init() < 0) {
    return -1;
  }
  while (1) {
    if (!sensor->is_online) {
      printk("\033[2J\033[H");
      printk("====================================\n");
      printk("         DJI DR16 RECEIVER          \n");
      printk("====================================\n");
      printk(" STATUS: OFFLINE\n");
    } else {
      printk("\033[2J\033[H");
      printk("==============================================\n");
      printk("              DJI DR16 RECEIVER               \n");
      printk("==============================================\n");
      printk(" STATUS: ONLINE   |  PACKETS: %-6u\n", my_app_data.packet_count);
      printk(" UPTIME: %-8u |  S1: %d  S2: %d\n", my_app_data.last_receive_time, sensor->info->s1, sensor->info->s2);
      printk("----------------------------------------------\n");
      printk(" [ RIGHT STICK ]  |  [ LEFT STICK ] \n");
      printk("  CH0 (X): %-6d |   CH2 (X): %-6d\n", sensor->info->ch0, sensor->info->ch2);
      printk("  CH1 (Y): %-6d |   CH3 (Y): %-6d\n", sensor->info->ch1, sensor->info->ch3);
      printk("----------------------------------------------\n");
      printk(" [ THUMBWHEEL ]   :  %-6d  (Steps: %d%d%d%d)\n",
             sensor->info->thumbwheel.value,
             sensor->info->thumbwheel.step[0], sensor->info->thumbwheel.step[1],
             sensor->info->thumbwheel.step[2], sensor->info->thumbwheel.step[3]);
      printk("----------------------------------------------\n");
      printk(" [ MOUSE AXES ]   |  [ MOUSE BUTTONS ]\n");
      printk("  VX: %-6d      |   LEFT:  %d (Cnt: %d)\n", sensor->info->mouse_vx, sensor->info->mouse_btn_l.value, sensor->info->mouse_btn_l.cnt);
      printk("  VY: %-6d      |   RIGHT: %d (Cnt: %d)\n", sensor->info->mouse_vy, sensor->info->mouse_btn_r.value, sensor->info->mouse_btn_r.cnt);
      printk("  VZ: %-6d      |\n", sensor->info->mouse_vz);
      printk("----------------------------------------------\n");
      printk(" [ KEYBOARD MAP ] Raw Vector: 0x%04X\n", sensor->info->key_v);
      printk("  W:%d S:%d A:%d D:%d | Q:%d E:%d R:%d F:%d | G:%d Z:%d X:%d C:%d\n",
             sensor->info->W.value, sensor->info->S.value, sensor->info->A.value, sensor->info->D.value,
             sensor->info->Q.value, sensor->info->E.value, sensor->info->R.value, sensor->info->F.value,
             sensor->info->G.value, sensor->info->Z.value, sensor->info->X.value, sensor->info->C.value);
      printk("  V:%d B:%d        | SHIFT:%d CTRL:%d\n",
             sensor->info->V.value, sensor->info->B.value, sensor->info->Shift.value, sensor->info->Ctrl.value);
      printk("==============================================\n");
    }
    // Refresh the screen at 10 Hz
    k_sleep(K_MSEC(100));
  }
  return 0;
}
```

## include/rc_thread.h
```c
/* samples/boards/dm_mc02/remote/include/rc_thread.h */
/*
 * Copyright (c) 2026 RobotPilots
 * SPDX-License-Identifier: Apache-2.0
 *
 * 组帧 + 解析线程，属于应用职责，不放在驱动里。
 * 驱动只负责把 UART 收到的字节交出来（remote_set_rx_cb）并说明本协议的帧格式
 * （remote_get_parser_ops），字节怎么拼成帧、在哪个线程解析由这里决定。
 */

#ifndef RC_THREAD_H_
#define RC_THREAD_H_

#include <drivers/remote/remote.h>
#include <zephyr/device.h>

#ifdef __cplusplus
extern "C" {
#endif

/**
 * @brief	把一路遥控设备接到组帧 + 解析线程上
 *
 * 做三件事：从驱动取 sensor 和本协议的 rc_parser_ops_t、给这路设备建组帧上下文
 * （环形缓冲 + 帧状态）、挂上 RX 字节回调。
 *
 * 解析线程在 K_THREAD_DEFINE 里就起来了，平时阻塞在信号量上，不需要另外启动。
 * 注意 attach 之前驱动收到的字节会被丢掉，所以越早调用越好。
 *
 * @retval 0		成功
 * @retval -EALREADY	该设备已经 attach 过
 * @retval -ENODEV	设备没就绪、没有 remote API，或者驱动给不出协议描述
 * @retval -ENOMEM	组帧上下文槽位用完了（见 RC_MAX_PARSERS）
 */
int rc_parse_attach(const struct device* dev);

/**
 * @brief	注册数据就绪回调
 *
 * 回调在**解析线程上下文**执行（不再是中断上下文），内部可以做耗时操作。
 *
 * @retval 0		成功
 * @retval -ENODEV	该设备还没 attach
 */
int rc_parse_set_data_ready_cb(const struct device* dev,
                               remote_data_ready_cb_t cb, void* user_data);

#ifdef __cplusplus
}
#endif

#endif /* RC_THREAD_H_ */
```

## src/rc_thread.c
```c
/* samples/boards/dm_mc02/remote/src/rc_thread.c */
/*
 * Copyright (c) 2026 RobotPilots
 * SPDX-License-Identifier: Apache-2.0
 */

#include "rc_thread.h"

#include <drivers/remote/rc_common.h>
#include <zephyr/device.h>
#include <zephyr/kernel.h>
#include <zephyr/logging/log.h>
#include <zephyr/sys/ring_buffer.h>
#include <zephyr/sys/util.h>

#define LOG_LEVEL CONFIG_REMOTE_LOG_LEVEL
LOG_MODULE_REGISTER(rc_thread);

/** 间隙法组帧阈值：距上一批字节超过该毫秒数即判定为新帧起点 */
#define RC_FRAME_GAP_MS 5

/** 当前最长的帧（VT13 21B）；DT7 是 18B */
#define RC_FRAME_MAX_SIZE 21

/** ISR → 解析线程 的单实例环形缓冲容量 */
#define RC_RX_RING_SIZE 256

/** 同时能挂几路遥控。DT7 和 VT13 通常只上一路，留两个余量 */
#define RC_MAX_PARSERS 2

/** 解析线程的栈大小与优先级。这两项只有本文件用，直接写在这里，
 *  应用侧不再带 Kconfig（见 Kconfig 已删）。
 *
 *  栈调大的场合只有一个：CONFIG_REMOTE_LOG_LEVEL 开到 DBG 时日志量很大。
 *  优先级要跟得上 14ms 一帧，但不应抢占控制环。 */
#define RC_PARSE_THREAD_STACK_SIZE 2048
#define RC_PARSE_THREAD_PRIO 7

/** 一路遥控的组帧上下文 */
typedef struct rc_parser {
  const struct device* dev;    /**< NULL 表示这个槽位空着 */
  const rc_parser_ops_t* ops;  /**< 由驱动经 remote_get_parser_ops() 给出 */
  rc_sensor_t* sensor;

  remote_data_ready_cb_t cb; /**< 应用回调，在解析线程上下文跑 */
  void* user_data;

  /* --- 组帧状态：只有解析线程访问 --- */
  uint8_t frame[RC_FRAME_MAX_SIZE];
  uint8_t frame_idx;
  /** ISR 检测到字节间空隙，线程在消费后续字节前先据此丢弃半帧 */
  volatile bool gap_pending;

  /* --- ISR 写 / 线程读，SPSC 无锁 --- */
  uint32_t last_feed_ms; /**< 仅 ISR 读写，用于判定空隙 */
  struct ring_buf rx_ring;
  uint8_t rx_ring_storage[RC_RX_RING_SIZE] __aligned(4);
} rc_parser_t;

K_SEM_DEFINE(rc_parse_sem, 0, 1);

static rc_parser_t rc_parsers[RC_MAX_PARSERS];

static rc_parser_t* rc_parser_find(const struct device* dev) {
  for (size_t i = 0; i < ARRAY_SIZE(rc_parsers); i++) {
    if (rc_parsers[i].dev == dev) {
      return &rc_parsers[i];
    }
  }
  return NULL;
}

/**
 *	@brief	一帧通过终检后的公共处理
 *
 * 顺序与原来的实现一致：
 * 解析 → 数据校验 → 鼠标滤波 → 置在线 → 应用回调
 *
 * 按键状态机（rc_keyboard_update()）不在这里推进，由使用方按自己的节奏调用。
 */
static void rc_parser_handle_frame(rc_parser_t* parser) {
  const rc_parser_ops_t* ops = parser->ops;
  rc_sensor_t* sensor = parser->sensor;

  LOG_HEXDUMP_DBG(parser->frame, ops->frame_size, "frame");

  if (ops->frame_check != NULL &&
      ops->frame_check(parser->frame, ops->frame_size) != RC_FRAME_OK) {
    LOG_DBG("frame rejected (%u bytes)", ops->frame_size);
    return;
  }

  ops->parse(parser->frame, sensor->info);

  rc_sensor_check(sensor);
  rc_interrupt_update(sensor);

  sensor->is_online = true;

  if (parser->cb != NULL) {
    parser->cb(parser->dev, sensor, parser->user_data);
  }
}

static void rc_parser_drain(rc_parser_t* parser) {
  uint8_t chunk[32];

  for (;;) {
    /* 字节的到达时刻只有 ISR 知道，所以空隙判定放在 rc_rx_cb()，
     * 它总在推入空隙之后的字节之前置位 gap_pending——这里先看标志再取数据，
     * 就一定能赶在那些字节之前把半帧丢掉。
     */
    if (parser->gap_pending) {
      parser->gap_pending = false;
      if (parser->frame_idx != 0) {
        LOG_DBG("byte gap, drop partial frame (idx=%u)", parser->frame_idx);
        parser->frame_idx = 0;
      }
    }

    uint32_t len = ring_buf_get(&parser->rx_ring, chunk, sizeof(chunk));
    if (len == 0) {
      return;
    }

    for (uint32_t i = 0; i < len; i++) {
      parser->frame[parser->frame_idx++] = chunk[i];
      if (parser->frame_idx == parser->ops->frame_size) {
        rc_parser_handle_frame(parser);
        parser->frame_idx = 0;
      }
    }
  }
}

static void rc_parse_thread_fn(void* p1, void* p2, void* p3) {
  ARG_UNUSED(p1);
  ARG_UNUSED(p2);
  ARG_UNUSED(p3);

  while (1) {
    k_sem_take(&rc_parse_sem, K_FOREVER);
    for (size_t i = 0; i < ARRAY_SIZE(rc_parsers); i++) {
      if (rc_parsers[i].dev != NULL) {
        rc_parser_drain(&rc_parsers[i]);
      }
    }
  }
}

K_THREAD_DEFINE(rc_parse_thread, RC_PARSE_THREAD_STACK_SIZE,
                rc_parse_thread_fn, NULL, NULL, NULL,
                RC_PARSE_THREAD_PRIO, 0, 0);

/**
 *	@brief	丢掉半帧、清空环形缓冲
 *
 * 只在 UART_RX_DISABLED 恢复路径上调用（中断上下文），避免半帧残留和后续字节
 * 拼出一个假帧。
 */
static void rc_parser_reset(rc_parser_t* parser) {
  parser->frame_idx = 0;
  parser->gap_pending = false;
  parser->last_feed_ms = k_uptime_get_32();
  ring_buf_reset(&parser->rx_ring);
}

/**
 *	@brief	驱动交出来的 RX 事件（中断上下文）
 *
 * 只做空隙判定、memcpy 进环形缓冲、唤醒解析线程，不解析。
 */
static void rc_rx_cb(const struct device* dev, remote_rx_event_t ev,
                     const uint8_t* buf, size_t len, void* user_data) {
  rc_parser_t* parser = user_data;

  if (ev == REMOTE_RX_RESET) {
    rc_parser_reset(parser);
    return;
  }

  if (len == 0) {
    return;
  }

  uint32_t now = k_uptime_get_32();
  if ((now - parser->last_feed_ms) >= RC_FRAME_GAP_MS) {
    parser->gap_pending = true;
  }
  parser->last_feed_ms = now;

  uint32_t put = ring_buf_put(&parser->rx_ring, buf, (uint32_t)len);
  if (put < len) {
    /* 解析线程没跟上，尾部字节被丢。gap_pending 会保证下一帧重新对齐 */
    LOG_WRN("rx ring full, dropped %u bytes", (uint32_t)(len - put));
  }

  k_sem_give(&rc_parse_sem);
}

int rc_parse_attach(const struct device* dev) {
  if (rc_parser_find(dev) != NULL) {
    LOG_WRN("device already attached");
    return -EALREADY;
  }

  rc_parser_t* parser = NULL;
  for (size_t i = 0; i < ARRAY_SIZE(rc_parsers); i++) {
    if (rc_parsers[i].dev == NULL) {
      parser = &rc_parsers[i];
      break;
    }
  }
  if (parser == NULL) {
    LOG_ERR("no free parser slot (RC_MAX_PARSERS=%d)", RC_MAX_PARSERS);
    return -ENOMEM;
  }

  rc_sensor_t* sensor = remote_get_sensor(dev);
  const rc_parser_ops_t* ops = remote_get_parser_ops(dev);
  if (sensor == NULL || ops == NULL || ops->parse == NULL ||
      ops->frame_size == 0 || ops->frame_size > RC_FRAME_MAX_SIZE) {
    LOG_ERR("device has no usable sensor / parser ops");
    return -ENODEV;
  }

  parser->ops = ops;
  parser->sensor = sensor;
  parser->cb = NULL;
  parser->user_data = NULL;
  parser->frame_idx = 0;
  parser->gap_pending = false;
  parser->last_feed_ms = k_uptime_get_32();
  ring_buf_init(&parser->rx_ring, sizeof(parser->rx_ring_storage),
                parser->rx_ring_storage);

  /* dev 最后写：解析线程只认 dev != NULL 的槽位，这样它要么跳过、要么看到
   * 一个已经填好的上下文。上一次 attach 的字节早已被 drain 完，
   * 且此刻还没挂 rx_cb，不会有新字节进来。 */
  parser->dev = dev;

  int ret = remote_set_rx_cb(dev, rc_rx_cb, parser);
  if (ret < 0) {
    parser->dev = NULL;
    LOG_ERR("failed to hook rx callback: %d", ret);
    return ret;
  }

  LOG_INF("remote attached: frame_size=%u", ops->frame_size);
  return 0;
}

int rc_parse_set_data_ready_cb(const struct device* dev,
                               remote_data_ready_cb_t cb, void* user_data) {
  rc_parser_t* parser = rc_parser_find(dev);
  if (parser == NULL) {
    LOG_ERR("device not attached, call rc_parse_attach() first");
    return -ENODEV;
  }

  parser->cb = cb;
  parser->user_data = user_data;
  return 0;
}
```
